
// https://github.com/HOCKULUS/ESP8266-Proxmox-Remote
#include <ESP8266WiFi.h>
#include <ESP8266HTTPClient.h>
#include <WiFiClientSecure.h>
#include <Bounce2.h>
#include <Adafruit_GFX.h>
#include <Adafruit_SSD1306.h>
#include <EEPROM.h>

#define SCREEN_WIDTH 128
#define SCREEN_HEIGHT 64
Adafruit_SSD1306 display(SCREEN_WIDTH, SCREEN_HEIGHT, &Wire, -1);

// WLAN
const char* ssid = ""; // Wifi Name
const char* password = "";

int frame = 0;

// Proxmox
const char* proxmoxHost = ""; //IP or Hostname
const char* nodeName = "vm-server-1"; //Proxmox Node Name
const char* apiToken = "username@pam!ESP=XXXXXXXX-XXXX-XXXX-XXXX-XXXXXXXXXXXX";

// Buttons
#define BTN_LEFT D5
#define BTN_RIGHT D6
#define BTN_POWER D7
#define BTN_MODE D8
Bounce btnLeft, btnRight, btnPower, btnMode;

static unsigned long pressStart = 0;
static bool longPressTriggered = false;
const unsigned long longPressTime = 800;

// VM Struktur
struct VM {
  int id;
  String name;
  bool online;
  bool running;
  bool locked;
};

VM vms[16]; // max 16 VMs
int vmCount = 0;
int selectedVM = 0;
int scrollOffset = 0;

// Display / Timing
unsigned long lastAction = 0;
const unsigned long sleepTimeout = 60000;
unsigned long lastCheck = 0;
const unsigned long checkInterval = 2000;
bool displayActive = true;
int vmIndexToCheck = 0;
const int VISIBLE_LINES = 5;
bool isIndexVisible(int idx) {
  if (vmCount <= VISIBLE_LINES) return true;
  for (int i = 0; i < VISIBLE_LINES; ++i) {
    int ii = (scrollOffset + i) % vmCount;
    if (ii == idx) return true;
  }
  return false;
}

// Lock Symbol
const unsigned char PROGMEM lockIcon[] = {
0x7c, 0x44, 0x44, 0xfe, 0xfe, 0xfe, 0xee, 0xee, 0xfe
};

// Power Symbol
const unsigned char PROGMEM powerIcon[] = {
0x08, 0x00, 0x49, 0x00, 0x88, 0x80, 0x88, 0x80, 0x80, 0x80, 0x80, 0x80, 0x80, 0x80, 0x41, 0x00, 
0x3e, 0x00
};

// Ethernet Symbol
const unsigned char PROGMEM ethernetIcon[] = {
0xff, 0xe0, 0x80, 0x20, 0xaa, 0xa0, 0xaa, 0xa0, 0x80, 0x20, 0x80, 0x20, 0xc0, 0x60, 0x71, 0xc0, 
0x1f, 0x00
};

// Wifi1 Symbol
const unsigned char PROGMEM wifi1Icon[] = {
0x00, 0x00, 0x00, 0x00, 0x00, 0x00, 0x00, 0x00, 0x00, 0x00, 0x00, 0x00, 0x00, 0x00, 0x00, 0x00, 
0x00, 0x00, 0x00, 0x00, 0x00, 0x00, 0x00, 0x00, 0x00, 0x00, 0x00, 0x00, 0x00, 0x00, 0x00, 0x00, 
0x00, 0x00, 0x00, 0x00, 0x00, 0x00, 0x00, 0x00, 0x00, 0x00, 0x00, 0x00, 0x00, 0x00, 0x00, 0x00, 
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0x00, 0x00, 0x00, 0x00, 0x00, 0x00, 0x00, 0x00, 0x00, 0x00, 0x00, 0x00, 0x00, 0x00, 0x00, 0x00
};

// Wifi2 Symbol
const unsigned char PROGMEM wifi2Icon[] = {
0x00, 0x00, 0x00, 0x00, 0x00, 0x00, 0x00, 0x00, 0x00, 0x00, 0x00, 0x00, 0x00, 0x00, 0x00, 0x00, 
0x00, 0x00, 0x00, 0x00, 0x00, 0x00, 0x00, 0x00, 0x00, 0x00, 0x00, 0x00, 0x00, 0x00, 0x00, 0x00, 
0x00, 0x00, 0x00, 0x00, 0x00, 0x00, 0x00, 0x00, 0x00, 0x00, 0x00, 0x00, 0x00, 0x00, 0x00, 0x00, 
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0x00, 0x00, 0x00, 0x00, 0x00, 0x00, 0x00, 0x00, 0x00, 0x00, 0x00, 0x00, 0x00, 0x00, 0x00, 0x00
};

// Wifi3 Symbol
const unsigned char PROGMEM wifi3Icon[] = {
0x00, 0x00, 0x00, 0x00, 0x00, 0x00, 0x00, 0x00, 0x00, 0x00, 0x00, 0x00, 0x00, 0x00, 0x00, 0x00, 
0x00, 0x00, 0x00, 0x00, 0x00, 0x00, 0x00, 0x00, 0x00, 0x00, 0x00, 0x00, 0x00, 0x00, 0x00, 0x00, 
0x00, 0x00, 0x00, 0x00, 0x00, 0x00, 0x00, 0x00, 0x00, 0x00, 0x00, 0x00, 0x00, 0x00, 0x00, 0x00, 
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0x00, 0x00, 0x00, 0x00, 0x00, 0x00, 0x00, 0x00, 0x00, 0x00, 0x00, 0x00, 0x00, 0x00, 0x00, 0x00
};

// Wifi4 Symbol
const unsigned char PROGMEM wifi4Icon[] = {
0x00, 0x00, 0x00, 0x00, 0x00, 0x00, 0x00, 0x00, 0x00, 0x00, 0x00, 0x00, 0x00, 0x00, 0x00, 0x00, 
0x00, 0x00, 0x00, 0x00, 0x00, 0x00, 0x00, 0x00, 0x00, 0x00, 0x00, 0x00, 0x00, 0x00, 0x00, 0x00, 
0x00, 0x00, 0x00, 0x00, 0x00, 0x00, 0x00, 0x00, 0x00, 0x00, 0x00, 0x00, 0x00, 0x00, 0x00, 0x00, 
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0x00, 0x00, 0x00, 0x00, 0x00, 0x00, 0x00, 0x00, 0x00, 0x00, 0x00, 0x00, 0x00, 0x00, 0x00, 0x00
};

void setup() {
  Serial.begin(115200);

  pinMode(BTN_LEFT, INPUT_PULLUP);
  pinMode(BTN_RIGHT, INPUT_PULLUP);
  pinMode(BTN_POWER, INPUT_PULLUP);
  pinMode(BTN_MODE, INPUT_PULLUP);

  btnLeft.attach(BTN_LEFT);
  btnRight.attach(BTN_RIGHT);
  btnPower.attach(BTN_POWER);
  btnMode.attach(BTN_MODE);
  btnLeft.interval(20);
  btnRight.interval(20);
  btnPower.interval(20);
  btnMode.interval(50);

  if (!display.begin(SSD1306_SWITCHCAPVCC, 0x3C)) {
    Serial.println("Display nicht gefunden");
    while (true);
  }

  WiFi.begin(ssid, password);
  Serial.print("Verbinde mit WLAN...");
  while (WiFi.status() != WL_CONNECTED) {
  display.clearDisplay();

  switch (frame % 4) { // 4 Frames
    case 0: display.drawBitmap(0, 0, wifi1Icon, 128, 64, SSD1306_WHITE); break;
    case 1: display.drawBitmap(0, 0, wifi2Icon, 128, 64, SSD1306_WHITE); break;
    case 2: display.drawBitmap(0, 0, wifi3Icon, 128, 64, SSD1306_WHITE); break;
    case 3: display.drawBitmap(0, 0, wifi4Icon, 128, 64, SSD1306_WHITE); break;
  }

  display.display();
  delay(500);

  frame++; // next Frame (Wifi)
  Serial.print(".");
}
  Serial.println(" verbunden!");
  display.clearDisplay();
  display.setTextSize(1);
  display.setTextColor(SSD1306_WHITE);
  display.setCursor(0,0);
  display.println("Suche VMs...");
  display.display();
  discoverVMs();
  drawVMList();
  lastAction = millis();
}

// ================== Loop ==================
void loop() {
  btnLeft.update();
  btnRight.update();
  btnPower.update();
  btnMode.update();

  bool pressed = false;

  if (vmCount > 0) {
    if (btnLeft.fell()) {
      if(displayActive) { 
        selectedVM = (selectedVM - 1 + vmCount) % vmCount;
        if (!isIndexVisible(selectedVM)) {
          scrollOffset = (scrollOffset - 1 + vmCount) % vmCount;
        }
      }
      pressed = true;
    }
    if (btnRight.fell()) {
      if(displayActive) {
        selectedVM = (selectedVM + 1) % vmCount;
        if (!isIndexVisible(selectedVM)) {
          scrollOffset = (scrollOffset + 1) % vmCount;
        }
      }
      pressed = true;
    }
    if (displayActive) {
  if (btnPower.fell()) {
    pressStart = millis();
    longPressTriggered = false;
    pressed = true;
  }
  if (btnPower.read() == LOW) {
      unsigned long pressDuration = millis() - pressStart;
      if (pressDuration >= longPressTime && !longPressTriggered) {
        Serial.println("Langer Druck → VM sperren");
        setVMLocked(vms[selectedVM], !(vms[selectedVM].locked)); // direkt sperren
        longPressTriggered = true;          // nur einmal pro Press
      }
    }
    if (btnPower.rose()) {
      unsigned long pressDuration = millis() - pressStart;

      if (pressDuration < longPressTime) {
        if (!vms[selectedVM].locked) {
          Serial.println("Kurzer Druck");
          handlePower(vms[selectedVM]);
        } else {
          displayInfo("Press and hold to remove lock");
        }
      }
    }
  }

  drawVMList();
  }

  if (pressed) {
    lastAction = millis();
    if (!displayActive) wakeDisplay();
  }

  if (displayActive && millis() - lastAction > sleepTimeout) sleepDisplay();

  if (displayActive && millis() - lastCheck > checkInterval) {
    updateOneVMStatus();
    lastCheck = millis();
  }
}

// ================== VM Discovery ==================
void discoverVMs() {
  WiFiClientSecure client;
  client.setInsecure();
  HTTPClient http;

  vmCount = 0;
  display.clearDisplay();
  display.setTextSize(1);
  display.setTextColor(SSD1306_WHITE);
  display.setCursor(0,0);
  display.println("Suche VMs...");
  display.display();

  int totalVMs = 130;
  int barWidth = SCREEN_WIDTH - 10;

  for (int id = 100; id <= totalVMs; id++) {
    String url = String("https://") + proxmoxHost + ":8006/api2/json/nodes/" + nodeName + "/qemu/" + id + "/status/current";
    if (http.begin(client, url)) {
      http.addHeader("Authorization", String("PVEAPIToken=") + apiToken);
      int code = http.GET();
      if (code == 200) {
        String payload = http.getString();
        bool running = payload.indexOf("\"status\":\"running\"") >= 0;

        String name = "VM " + String(id);
        int nameStart = payload.indexOf("\"name\":\"");
        if (nameStart>0) {
          nameStart += 8;
          int nameEnd = payload.indexOf("\"", nameStart);
          if (nameEnd>nameStart) name = payload.substring(nameStart, nameEnd);
        }

        bool locked = false;
        int tagStart = payload.indexOf("\"tags\":\"");
        if (tagStart >= 0) {
          tagStart += 8;
          int tagEnd = payload.indexOf("\"", tagStart);
          if (tagEnd > tagStart) {
            String tags = payload.substring(tagStart, tagEnd);
            locked = tags.indexOf("locked") >= 0;
          }
        }
        vms[vmCount].locked = locked;

        // VM speichern
        vms[vmCount].id = id;
        vms[vmCount].name = name;
        vms[vmCount].running = running;
        vmCount++;

        Serial.println("→ " + name);
        int y = 16 + (vmCount-1)*10;
        display.fillRect(0, 10, SCREEN_WIDTH, 10, SSD1306_BLACK);
        display.setCursor(0, 10);
        display.print("-> ");
        display.print(name);
        display.print(" ");
        display.display();
      }
      http.end();
    }
    int current = id - 100 + 1;
    int progress = (barWidth / (totalVMs - 100) ) * current;
    int barX = 5;
    int barY = SCREEN_HEIGHT - 10;
    int barH = 5;
    display.fillRect(barX, barY, barWidth, barH, SSD1306_BLACK);
    display.drawRect(barX, barY, barWidth, barH, SSD1306_WHITE);
    display.fillRect(barX, barY, progress, barH, SSD1306_WHITE);
    Serial.println(progress);
    Serial.println(barWidth);
    Serial.println(current);
    display.display();
  }

  if (vmCount == 0) {
    vms[0] = {0, "Keine VMs", false};
    vmCount = 1;
    display.fillRect(0,16,SCREEN_WIDTH,10,SSD1306_BLACK);
    display.setCursor(0,16);
    display.println("Keine VMs gefunden");
    display.display();
  }

  delay(50);
}

// ================== Anzeige ==================
void drawVMList() {
  display.clearDisplay();
  display.setTextSize(1);
  int visible = min(VISIBLE_LINES, vmCount);
  for (int i = 0; i < visible; i++) {
    int index = (scrollOffset + i) % vmCount;
    int y = i * 12;
    if (index == selectedVM) {
      display.fillRect(0, y, SCREEN_WIDTH, 12, SSD1306_WHITE);
      display.setTextColor(SSD1306_BLACK);
    } else {
      display.setTextColor(SSD1306_WHITE);
    }
    display.setCursor(2, y + 2);
    display.print(vms[index].name);
    if (vms[index].locked == true){
      if (index == selectedVM) {
        display.drawBitmap(106, y+1, lockIcon, 7, 9, SSD1306_BLACK);
      }
      else{
        display.drawBitmap(106, y+1, lockIcon, 7, 9, SSD1306_WHITE);
      }
    }
    if (vms[index].running) {
      if (index == selectedVM ) {
        display.drawBitmap(117, y+1, powerIcon, 9, 9, SSD1306_BLACK);
      }
      else{
        display.drawBitmap(117, y+1, powerIcon, 9, 9, SSD1306_WHITE);
      }
    }
  }
  for (int i = visible; i < VISIBLE_LINES; ++i) {
    int y = i * 12;
    display.fillRect(0, y, SCREEN_WIDTH, 12, SSD1306_BLACK);
  }
  display.display();
}

// ================== Status Updates ==================
void updateOneVMStatus() {
  if (vmCount==0) return;

  String url = String("https://") + proxmoxHost + ":8006/api2/json/nodes/" + nodeName + "/qemu/" + vms[vmIndexToCheck].id + "/status/current";
  WiFiClientSecure client;
  client.setInsecure();
  HTTPClient http;
  if (http.begin(client, url)) {
    http.addHeader("Authorization", String("PVEAPIToken=") + apiToken);
    int code = http.GET();
    if (code == 200) {
      String payload = http.getString();
      vms[vmIndexToCheck].running = payload.indexOf("\"status\":\"running\"")>=0;
      bool locked = false;
      int tagStart = payload.indexOf("\"tags\":\"");
      if (tagStart >= 0) {
        tagStart += 8;
        int tagEnd = payload.indexOf("\"", tagStart);
        if (tagEnd > tagStart) {
          String tags = payload.substring(tagStart, tagEnd);
          locked = tags.indexOf("locked") >= 0;
        }
      }
      vms[vmIndexToCheck].locked = locked;
    }
    http.end();
  }
  vmIndexToCheck = (vmIndexToCheck + 1) % vmCount;
  drawVMList();
}

// ================== Lock Update ==================
void setVMLocked(VM &vm, bool locked) {
  WiFiClientSecure client;
  client.setInsecure();
  HTTPClient http;
  String getUrl = String("https://") + proxmoxHost + ":8006/api2/json/nodes/" + nodeName + "/qemu/" + vm.id + "/config";
  String tags = "";
  if (http.begin(client, getUrl)) {
    http.addHeader("Authorization", String("PVEAPIToken=") + apiToken);
    int code = http.GET();
    if (code == 200) {
      String payload = http.getString();
      int t1 = payload.indexOf("\"tags\":\"");
      if (t1 > 0) {
        t1 += 8;
        int t2 = payload.indexOf("\"", t1);
        if (t2 > t1) tags = payload.substring(t1, t2);
      }
    }
    http.end();
  }
  tags.trim();
  bool hasLocked = tags.indexOf("locked") >= 0;

  if (locked && !hasLocked) {
    tags += ";locked";
  } else if (!locked && hasLocked) {
    int pos = tags.indexOf("locked");
    if (pos >= 0) {
      int end = tags.indexOf(";", pos);
      if (end >= 0) tags.remove(pos, end - pos + 1);
      else tags.remove(pos);
    }
    tags.trim();
    if (tags.endsWith(";")) tags.remove(tags.length() - 1);
  }
  String putUrl = getUrl;
  tags.replace(";", "%3B");
  String body = "tags=" + tags;
  if (http.begin(client, putUrl)) {
    http.addHeader("Authorization", String("PVEAPIToken=") + apiToken);
    http.addHeader("Content-Type", "application/x-www-form-urlencoded");
    int code = http.sendRequest("PUT", body);
    if (code == 200) {
      Serial.println(locked ? "VM gesperrt (Tag 'locked' gesetzt)" : "VM entsperrt ('locked' entfernt)");
      vm.locked = locked;
    } else {
      Serial.print("Fehler beim Setzen des Tags: ");
      Serial.print(code);
    }
    http.end();
  }
  drawVMList();
}

// ================== Hinweis Funktion ==================
void displayInfo(const String &text) {
  int boxWidth = 120;
  int boxHeight = 56;
  int x = (SCREEN_WIDTH - boxWidth) / 2;
  int y = (SCREEN_HEIGHT - boxHeight) / 2;
  display.fillRect(x, y, boxWidth, boxHeight, SSD1306_BLACK);
  display.drawRect(x, y, boxWidth, boxHeight, SSD1306_WHITE);
  display.setTextSize(1);
  display.setTextColor(SSD1306_WHITE);
  display.setCursor(x + (boxWidth - 8*4) / 2, y + 2);
  display.println("Info");
  int textY = y + 2 + 12*2;
  display.setCursor(x + 4, textY);
  display.println(text);
  display.display();
  delay(700);
  drawVMList();
}

// ================== Power Control ==================
void handlePower(VM &vm) {
  if (vm.id==0) return;
  String action = vm.running?"stop":"start";
  String url = String("https://")+proxmoxHost+":8006/api2/json/nodes/"+nodeName+"/qemu/"+vm.id+"/status/"+action;
  WiFiClientSecure client;
  client.setInsecure();
  HTTPClient http;
  if (http.begin(client,url)) {
    http.addHeader("Authorization", String("PVEAPIToken=")+apiToken);
    http.sendRequest("POST");
    http.end();
  }
  vm.running = !vm.running;
  drawVMList();
}

// ================== Display Power ==================
void sleepDisplay() {
  Serial.println("Display aus und Abfragen gestoppt");
  display.ssd1306_command(SSD1306_DISPLAYOFF);
  displayActive = false;
}

void wakeDisplay() {
  Serial.println("Display an und Abfragen fortgesetzt");
  display.ssd1306_command(SSD1306_DISPLAYON);
  displayActive = true;
  lastCheck = 0;
}
